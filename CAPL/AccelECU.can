/*@!Encoding:949*/
includes
{
  
}

variables
{
  float accelPedalPosition;
}

on sysvar sysvar::Chassis::accelAngle
{
  accelPedalPosition = @sysvar::Chassis::accelAngle;
  $frmAccelMsg::AccelAngle = accelPedalPosition;
}

