/*@!Encoding:949*/
includes
{
  
}

variables
{
  float pedalPosition;
}

on message frmAccelMsg
{
  pedalPosition = this.AccelAngle;

  @sysvar::Car::Car_ACC = accelPedalPosition;
  $frmAccelMsg::AccelAngle = @sysvar::Car::Car_ACC;
}

