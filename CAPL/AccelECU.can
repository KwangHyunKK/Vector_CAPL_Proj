/*@!Encoding:949*/
includes
{
  
}

variables
{
  float accelPedalPosition;
}

on message frmAccelMsg
{
  accelPedalPosition = this.AccelAngle;
  
  @sysvar::Chassis::AccelAngle = accelPedalPosition;
  $frmAccelMsg::AccelAngle = @sysvar::Chassis::AccelAngle;
}