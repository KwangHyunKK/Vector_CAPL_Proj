/*@!Encoding:949*/
includes
{
  
}

variables
{
  float accelPedalPosition;
}

on sysvar sysvar::Chassis::AccelAngle
{
  accelPedalPosition = @sysvar::Chassis::AccelAngle;
  $frmAccelMsg::AccelAngle = accelPedalPosition;
}

