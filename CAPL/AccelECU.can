/*@!Encoding:949*/
includes
{
  
}

variables
{
  float pedalPosition;
}

on message frmAccelMsg
{
  pedalPosition = this.AccelAngle;

  @sysvar::Chassis::accelAngle = pedalPosition;
  $frmAccelMsg::AccelAngle = @sysvar::Chassis::accelAngle;
}

