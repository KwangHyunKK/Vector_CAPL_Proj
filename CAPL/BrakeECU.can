/*@!Encoding:949*/
includes
{
  
}

variables
{
  float brakePedalPosition;
}

on sysvar sysvar::Chassis::BrakeAngle
{
  brakePedalPosition = @sysvar::Chassis::BrakeAngle;
  $frmBrakeMsg::BrakeAngle = brakePedalPosition;
}
