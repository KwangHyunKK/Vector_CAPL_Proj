/*@!Encoding:949*/
includes
{
  
}

variables
{
  float brakePedalPosition;
}

on sysvar sysvar::Chassis::brakeAngle
{
  brakePedalPosition = @sysvar::Chassis::brakeAngle;
  $frmBrakeMsg::BrakeAngle = brakePedalPosition;
}
