/*@!Encoding:949*/
includes
{
  
}

variables
{
  float brakePedalPosition;
}

on message frmBrakeMsg
{
  brakePedalPosition = this.BrakeAngle;
  
  @sysvar::Car::Car_Brake = brakePedalPosition;
  $frmBrakeMsg::BrakeAngle = @sysvar::Car::Car_Brake;
}
