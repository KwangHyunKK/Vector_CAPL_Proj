/*@!Encoding:949*/
includes
{
  
}

variables
{
  float brakePedalPosition;
}

on message frmBrakeMsg
{
  brakePedalPosition = this.BrakeAngle;
  
  @sysvar::Chassis::brakeAngle = brakePedalPosition;
  $frmBrakeMsg::BrakeAngle = @sysvar::Chassis::brakeAngle;
}
