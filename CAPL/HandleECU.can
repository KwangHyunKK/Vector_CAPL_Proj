/*@!Encoding:949*/
includes
{
  
}

variables
{
  msTimer tmrCycle;
  int CurrSleepLev;
  int PrevSleepLev;
  int VibCount;
}

on start
{
  CurrSleepLev = 0;
  PrevSleepLev = 0;
  VibCount = 0;
  
  setTimerCyclic(tmrCycle, 500);
}

on message Chassis::frmDriverStateWarnMsg
{
  @sysvar::Chasshi::SleepLevel = this.SleepinessLevel.phys;
}

on sysvar sysvar::Gui::SleepLevel
{
  CurrSleepLev = @sysvar::Chasshi::SleepLevel;
  if (CurrSleepLev == PrevSleepLev + 1)
  {
    VibCount = 1;
  }
  PrevSleepLev = CurrSleepLev;
}

on timer tmrCycle
{
  if (VibCount > 0)
  {
    VibCount++;
    @sysvar::Chasshi::HandleVib++;
    @sysvar::Chasshi::HandleVib %= 2;

    if (VibCount % 8 == 0)
    {
      VibCount = 0;
      @sysvar::Chasshi::HandleVib = 0;
    }
  }
}
