/*@!Encoding:949*/
includes
{
  
}

variables
{
  msTimer tmrCycle;
  int CurrSleepLev;
  int PrevSleepLev;
  int VibCount;
}

on start
{
  CurrSleepLev = 0;
  PrevSleepLev = 0;
  VibCount = 0;
  
  setTimerCyclic(tmrCycle, 200);
}

on message Chassis::frmDriverStateWarnMsg
{
  CurrSleepLev = this.SleepinessLevel.phys;
  if (CurrSleepLev == PrevSleepLev + 1)
  {
    VibCount = 1;
  }
  PrevSleepLev = CurrSleepLev;
}

on timer tmrCycle
{
  if (VibCount > 0)
  {
    VibCount++;
    @sysvar::Chassis::HandleVib++;
    @sysvar::Chassis::HandleVib %= 2;

    if (VibCount % 15 == 0) // 3초 동안 움직임
    {
        @sysvar::Chassis::handleVib++;
        if(@sysvar::Chassis::handleVib % 8 == 0)
        {
            flag = 0;
            @sysvar::Chassis::handleVib = 0;
        }
    }
  }
}
