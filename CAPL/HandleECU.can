/*@!Encoding:949*/
includes
{
  
}

variables
{
  msTimer tmrCycle;
  int CurrSleepLev;
  int PrevSleepLev;
  int VibCount;
}

on start
{
  CurrSleepLev = 0;
  PrevSleepLev = 0;
  VibCount = 0;
  
  setTimerCyclic(tmrCycle, 200);
}

on message Chassis::frmDriverStateWarnMsg
{
  @sysvar::Chassis::sleepLevel = this.SleepinessLevel.phys;
}

on sysvar sysvar::Chassis::sleepLevel
{
  CurrSleepLev = @sysvar::Chassis::sleepLevel;
  if (CurrSleepLev == PrevSleepLev + 1)
  {
    VibCount = 1;
  }
  PrevSleepLev = CurrSleepLev;
}

on timer tmrCycle
{
  if (VibCount > 0)
  {
    VibCount++;
    @sysvar::Chassis::handleVib++;
    @sysvar::Chassis::handleVib %= 2;

    if (VibCount % 15 == 0) // 3�� ���� ������
    {
      VibCount = 0;
      @sysvar::Chassis::handleVib = 0;
    }
  }
}
