/*@!Encoding:949*/
includes
{
  
}

variables
{
  msTimer tmrCycle;
  int CurrSleepLev;
  int PrevSleepLev;
  int VibCount;
}

on start
{
  CurrSleepLev = 0;
  PrevSleepLev = 0;
  VibCount = 0;
  
  setTimerCyclic(tmrCycle, 200);
}

on message Chassis::frmDriverStateWarnMsg
{
  @sysvar::Chassis::SleepLevel = this.SleepinessLevel.phys;
}

on sysvar sysvar::Chassis::SleepLevel
{
  CurrSleepLev = @sysvar::Chassis::SleepLevel;
  if (CurrSleepLev == PrevSleepLev + 1)
  {
    VibCount = 1;
  }
  PrevSleepLev = CurrSleepLev;
}

on timer tmrCycle
{
  if (VibCount > 0)
  {
    VibCount++;
    @sysvar::Chassis::HandleVib++;
    @sysvar::Chassis::HandleVib %= 2;

    if (VibCount % 15 == 0) // 3초 동안 움직임
    {
      VibCount = 0;
      @sysvar::Chassis::HandleVib = 0;
    }
  }
}
