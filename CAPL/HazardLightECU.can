/*@!Encoding:949*/
includes
{
  
}

variables
{
  int timerOn;
  int cnt;
}

on sysvar_update Body::lightStatus
{
  timerOn = @Body::lightStatus;
  if(timerOn == 1)
  {
    @sysvar::Body::leftArrow = @sysvar::Body::leftArrow ^ 1;
    @sysvar::Body::rightArrow = @sysvar::Body::rightArrow ^ 1;
    $LightOnStatus = timerOn;
  }
  else
  {
    @sysvar::Body::leftArrow = 0;
    @sysvar::Body::rightArrow = 0;
  }
}


on message frmDriverStateWarnMsg
{
  if(this.SleepinessLevel == 3 && @Body::lightStatus == 0)
  {
    timerOn = 1;
    @Body::lightStatus = 1;
    $LightOnStatus = timerOn;
  }
  if(timerOn == 1)
  {
    if(cnt == 3)
    {
      @sysvar::Body::leftArrow = @sysvar::Body::leftArrow ^ 1;
      @sysvar::Body::rightArrow = @sysvar::Body::rightArrow ^ 1;
      cnt = 0;
    }
    ++cnt;
  }
}