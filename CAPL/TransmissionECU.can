/*@!Encoding:949*/
includes
{
  
}

variables
{
  // 재호출 방지를 위한 변수
  int block_flag = 0;
}

// P 버튼이 눌리거나 다른 버튼이 눌려서 꺼졌을 때 동작
on sysvar Button::button_P
{
  write("in P");
  // 1인 상태에서 한번 더 눌렀을 때, 그대로 유지되어야 함.
  if(block_flag == 0 && @sysvar::Button::button_P == 0){
    // 버튼 다시 키는 동작 수행
    @sysvar::Button::button_P = 1;
    write("pressed_P value: %d", @sysvar::Button::button_P);
    // 값이 변경되어 본 함수가 재 호출 될 때, 값 혼동을 막기 위해 block 변수 set
    block_flag = 1;
  }
  else{
    write("In P Signal value: %d", block_flag);
    // 재 호출 방지를 위한 block 변수 처리
    if(block_flag == 1) block_flag = 0;
    else{
      // 버튼 상태를 나타내는 curState에 현재 버튼 값 넣어 줌
      @sysvar::Button::curState = 0;
      // 다른 버튼이 꺼져야 하므로, 재호출 변수 SET
      block_flag = 1;
      // 켜져 있는 한개의 버튼 OFF 상태로 변경
      if(@sysvar::Button::button_R == 1) @sysvar::Button::button_R = 0;
      if(@sysvar::Button::button_N == 1) @sysvar::Button::button_N = 0;
      if(@sysvar::Button::button_D == 1) @sysvar::Button::button_D = 0;
    }
    write("OUT P Signal value: %d", block_flag);
  }
  write("finish P");
}

on sysvar Button::button_R
{
  write("in R");
  if(block_flag == 0 && @sysvar::Button::button_R == 0){
    @sysvar::Button::button_R = 1;
    block_flag = 1;
  }
  else{
    write("In R Signal value: %d", block_flag);
    if(block_flag == 1) block_flag = 0;
    else{
      @sysvar::Button::curState = 1;
      block_flag = 1;
      if(@sysvar::Button::button_P == 1) @sysvar::Button::button_P = 0;
      if(@sysvar::Button::button_N == 1) @sysvar::Button::button_N = 0;
      if(@sysvar::Button::button_D == 1) @sysvar::Button::button_D = 0;
    }
    write("OUT R Signal value: %d", block_flag);
  }
  write("finish R");
}

on sysvar Button::button_N
{
  write("in N");
  if(block_flag == 0 && @sysvar::Button::button_N == 0){
    @sysvar::Button::button_N = 1;
    block_flag = 1;
  }
  else{
    write("In N Signal value: %d", block_flag);
    if(block_flag == 1) block_flag = 0;
    else{
      @sysvar::Button::curState = 2;
      block_flag = 1;
      if(@sysvar::Button::button_R == 1) @sysvar::Button::button_R = 0;
      if(@sysvar::Button::button_P == 1) @sysvar::Button::button_P = 0;
      if(@sysvar::Button::button_D == 1) @sysvar::Button::button_D = 0;
    }
    write("OUT N Signal value: %d", block_flag);
  }
  write("finish N");
}

on sysvar_update Button::button_D
{
  write("in D");
  if(block_flag == 0 && @sysvar::Button::button_D == 0){
    @sysvar::Button::button_D = 1;
    block_flag = 1;
  }
  else{
    write("In D Signal value: %d", block_flag);
    if(block_flag == 1) block_flag = 0;
    else{
      @sysvar::Button::curState = 3;
      block_flag = 1;
      if(@sysvar::Button::button_R == 1) @sysvar::Button::button_R = 0;
      if(@sysvar::Button::button_N == 1) @sysvar::Button::button_N = 0;
      if(@sysvar::Button::button_P == 1) @sysvar::Button::button_P = 0;
    }
    write("OUT D Signal value: %d", block_flag);
  }
  write("finish D");
}

// 버튼 상태를 알리는 전역변수의 값을 Transmission ECU가 보내는 메세지 내용과 같게 설정
on sysvar Button::curState
{
  $TransmissionECU::curGearStatus = @sysvar::Button::curState;
} 