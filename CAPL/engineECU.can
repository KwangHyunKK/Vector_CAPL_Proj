/*@!Encoding:949*/
includes
{
  
}
variables
{
  float vSpeed = 0;
  float vTemp = 30;
  float brakeAng = 0;
  float accelAng = 0;
  float engineRPM = 0;
  float targetSpeed = 0;
  int driverState = 0;
  int curGearState = 0;
}

on message CAN1::frmDriverStateWarnMsg{
  driverState = this.SleepinessLevel;
  targetSpeed = vSpeed;
}

on message CAN1::frmTransMsg{
  curGearState = this.curGearStatus;
}

on message CAN1::frmAccelMsg{
  if(@sysvar::IGN::lgnStart == 1){
      accelAng = this.AccelAngle.phys;
      if(brakeAng == 0){
        if(accelAng > 0){
          if(curGearState == 3)vSpeed += 0.324 * (accelAng * 0.033);
          else if(curGearState == 1)vSpeed += 0.162 * (accelAng * 0.033);
        }
        else{
          vSpeed -= 0.072;
        }
        if(vSpeed > 255){
          vSpeed = 255; 
        }
        else if(vSpeed < 0){
          vSpeed = 0;
        }
        
        if(driverState > 0 && vSpeed > targetSpeed){
         vSpeed = targetSpeed; 
        }

        if(curGearState == 2)
        {
          vSpeed = targetSpeed - 0.2;
          if(vSpeed < 0)vSpeed = 0;
        }
        
        $frmEngineMsg::VehicleSpeed = vSpeed;
        
        if(curGearState == 3)
        {
          if(0 <= vSpeed && vSpeed < 20){
            engineRPM = vSpeed * (5000 / (20 - 0));
          }
          else if (20 <= vSpeed && vSpeed < 50){
            engineRPM = (vSpeed-20) * (4000 / (50 - 20)) + 1500;
          }
          else if(50 <= vSpeed && vSpeed < 90){
            engineRPM = (vSpeed-50) * (4000 / (90 - 50)) + 1500;
          }
          else if(90 <= vSpeed && vSpeed < 160){
            engineRPM = (vSpeed-90) * (4000 / (160 - 90)) + 1500;
          }
          else{
            engineRPM = (vSpeed-160) * (6000 / (255 - 160)) + 1500;
          }
        }

        if(curGearState == 1)
        {
          engineRPM = 800 * _log10(vSpeed + 1) + 1000;
        }
        
        $frmEngineMsg::EngineRPM = engineRPM;
      }
  }
}
on message CAN1::frmBrakeMsg{
    if(@sysvar::IGN::lgnStart == 1){
      brakeAng = this.BrakeAngle.phys;
      
      if(curGearState == 0)brakeAng = 30;
      vSpeed -= 0.3528 * (brakeAng * 0.033);
      if(vSpeed < 0){
          vSpeed = 0;
       }
      
       $frmEngineMsg::VehicleSpeed = vSpeed;
    if(curGearState == 1)
    {
      engineRPM = 800 * _log10(vSpeed + 1) + 1000;
    }
    else 
    {
      if(0 <= vSpeed && vSpeed < 20){
        engineRPM = vSpeed * (5000 / (20 - 0));
      }
      else if (20 <= vSpeed && vSpeed < 50){
        engineRPM = (vSpeed-20) * (4000 / (50 - 20)) + 1500;
      }
      else if(50 <= vSpeed && vSpeed < 90){
        engineRPM = (vSpeed-50) * (4000 / (90 - 50)) + 1500;
      }
      else if(90 <= vSpeed && vSpeed < 160){
        engineRPM = (vSpeed-90) * (4000 / (160 - 90)) + 1500;
      }
      else{
        engineRPM = (vSpeed-160) * (6000 / (255 - 160)) + 1500;
      }
    }
        
        $frmEngineMsg::EngineRPM = engineRPM;
  }
}